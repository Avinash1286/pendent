/* Copyright (c) 2021 Nordic Semiconductor ASA
 * SPDX-License-Identifier: Apache-2.0
 * DK BENCH ONLY: pins from Zephyr v4.2.0's nRF52840 DK DMIC sample.
 * This is not an AURA pinout or permission to flash an AURA board.
 * Init applies this pinctrl; the resource probe never starts capture.
 */
&pinctrl {
	aura_dk_pdm_default: aura_dk_pdm_default {
		group1 {
			psels = <NRF_PSEL(PDM_CLK, 0, 30)>,
				<NRF_PSEL(PDM_DIN, 0, 31)>;
		};
	};
};

dmic_dev: &pdm0 {
	compatible = "aura,nrf-pdm";
	status = "okay";
	pinctrl-0 = <&aura_dk_pdm_default>;
	pinctrl-names = "default";
	clock-source = "PCLK32M_HFXO";
	queue-size = <4>;
};
