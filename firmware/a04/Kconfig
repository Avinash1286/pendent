## firmware/a04/Kconfig
```kconfig
mainmenu "AURA A04 DK integration probe"
source "Kconfig.zephyr"
rsource "drivers/Kconfig"
```

## firmware/a04/drivers/Kconfig
```kconfig
# SPDX-License-Identifier: Apache-2.0
config AURA_DMIC_NRFX_PDM
	bool "AURA monitored nRF52840 PDM driver"
	depends on AUDIO_DMIC && SOC_NRF52840 && !SMP
	depends on DT_HAS_AURA_NRF_PDM_ENABLED
	depends on !AUDIO_DMIC_NRFX_PDM
	select NRFX_PDM0
	select PINCTRL
	help
	  Pinned Zephyr 4.2 PDM driver with sticky transfer faults, source release
	  sequencing and explicit asynchronous shutdown ownership. Use compatible
	  aura,nrf-pdm; the stock DMIC driver must not own this peripheral.
```

## firmware/a04/drivers/dts/bindings/audio/aura,nrf-pdm.yaml
```yaml
# Copyright (c) 2019 Nordic Semiconductor ASA
# SPDX-License-Identifier: Apache-2.0
description: AURA monitored nRF52840 PDM interface
compatible: "aura,nrf-pdm"
include: ["base.yaml", "pinctrl-device.yaml", "memory-region.yaml", "nordic-clockpin.yaml"]
properties:
  reg:
    required: true
  interrupts:
    required: true
  pinctrl-0:
    required: true
  pinctrl-names:
    required: true
  clock-source:
    type: string
    default: "PCLK32M_HFXO"
    enum: ["PCLK32M", "PCLK32M_HFXO"]
    description: PCLK32M from the peripheral clock or requested HFXO.
  queue-size:
    type: int
    default: 4
    description: Number of completed blocks retained pending application read.
```

## firmware/boards/aura/aura_a03/board.yml
```yaml
board:
  name: aura_a03
  full_name: AURA A03 Raytac MDBT50Q-1MV2
  vendor: aura
  socs:
    - name: nrf52840
```
